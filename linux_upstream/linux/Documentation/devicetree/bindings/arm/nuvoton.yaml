## linux_upstream/linux/Documentation/devicetree/bindings/arm/nuvoton.yaml
```yaml
# SPDX-License-Identifier: (GPL-2.0 OR BSD-2-Clause)
%YAML 1.2
---
$id: http://devicetree.org/schemas/arm/nuvoton.yaml#
$schema: http://devicetree.org/meta-schemas/core.yaml#

title: Nuvoton Platforms Device Tree Bindings

maintainers:
  - Jacky Huang <ychuang3@nuvoton.com>
  - Shan-Chun Hung <schung@nuvoton.com>

description: |
  Boards with an ARMv8 based Nuvoton SoC shall have the following
  properties.

properties:
  $nodename:
    const: '/'
  compatible:
    oneOf:

      - description: MA35D1 based boards
        items:
          - enum:
              - nuvoton,ma35d1-iot
          - const: nuvoton,ma35d1

additionalProperties: true
...
```

## linux_upstream/linux/Documentation/devicetree/bindings/serial/nuvoton,ma35d1-serial.yaml
```yaml
# SPDX-License-Identifier: GPL-2.0
%YAML 1.2
---
$id: http://devicetree.org/schemas/serial/nuvoton,ma35d1-serial.yaml#
$schema: http://devicetree.org/meta-schemas/core.yaml#

title: Nuvoton MA35D1 UART

maintainers:
  - Min-Jen Chen <mjchen@nuvton.com>
  - Shan-Chun Hung <schung@nuvoton.com>

description:
  The Nuvoton MA35D1 SoC UART Serial Interface provides a hardware UART for
  drivers of MA35D1 on-chip controllers/peripherals.

properties:
  compatible:
    enum:
      - nuvoton,ma35d1-serial

  reg:
    maxItems: 1

  interrupts:
    maxItems: 1
    
  clocks:
    maxItems: 1

  dmas:
    items:
      - description: DMA controller phandle and request line for RX
      - description: DMA controller phandle and request line for TX

  dma-names:
    items:
      - const: rx
      - const: tx

required:
  - compatible
  - reg
  - interrupts
  - clocks

additionalProperties: false

examples:
  - |
    aliases {
        serial1 = &uart1;
    };
    
    uart1: serial@40710000 {
        compatible = "nuvoton,ma35d1-uart";
        reg = <0x0 0x40710000 0x0 0x10000>;
        interrupts = <GIC_SPI 60 IRQ_TYPE_LEVEL_HIGH>;
        dmas = <&pdma2 2>,<&pdma3 3>;
        dma-names = "tx", "rx";
        clocks = <&clk UART1_GATE>;
        status = "okay";
    };
```

## linux_upstream/linux/temp/Documentation/devicetree/bindings/clock/nuvoton,ma35d1-clk.yaml
```yaml
# SPDX-License-Identifier: (GPL-2.0-only OR BSD-2-Clause)
%YAML 1.2
---
$id: http://devicetree.org/schemas/clock/nuvoton,ma35d1-clk.yaml#
$schema: http://devicetree.org/meta-schemas/core.yaml#

title: Nuvoton MA35D1 Clock Control Module Binding

maintainers:
  - Chi-Fang Li <cfli0@nuvoton.com>
  - Jacky Huang <ychuang3@nuvoton.com>

description: |
  The MA35D1 clock controller generates clocks for the whole chip,
  including system clocks and all peripheral clocks.

  See also:
    include/dt-bindings/clock/ma35d1-clk.h

properties:
  compatible:
    const: nuvoton,ma35d1-clk

  reg:
    maxItems: 1

  "#clock-cells":
    const: 1

  clocks:
    items:
      - description: External 24MHz crystal

  clock-names:
    items:
      - const: hxt_24m

  assigned-clocks:
    maxItems: 5

  assigned-clock-rates:
    maxItems: 5

  nuvoton,clk-pll-mode:
    description:
      A list of PLL operation mode corresponding to CAPLL, DDRPLL, APLL,
      EPLL, and VPLL in sequential. The operation mode value 0 is for
      integer mode, 1 is for fractional mode, and 2 is for spread
      spectrum mode.
    $ref: /schemas/types.yaml#/definitions/uint32-array
    maxItems: 5
    items:
      minimum: 0
      maximum: 2

required:
  - compatible
  - reg
  - "#clock-cells"

additionalProperties: false

examples:
  - |
    #include <dt-bindings/clock/nuvoton,ma35d1-clk.h>

    clk: clock-controller@40460200 {
        compatible = "nuvoton,ma35d1-clk";
        reg = <0x0 0x40460200 0x0 0x100>;
        #clock-cells = <1>;
        clocks = <&hxt_24m>;
        clock-names = "HXT_24MHz";
    };
...
```
